## sdkconfig.defaults
```kconfig
CONFIG_NVS_ENCRYPTION=y
CONFIG_NVS_ENCRYPTION_KEY_STORAGE=2
CONFIG_MBEDTLS_CERTIFICATE_BUNDLE=y
CONFIG_ESP_TLS_USE_SECURE_ELEMENT=n
CONFIG_OTA_ALLOW_HTTP=n
CONFIG_BOOTLOADER_APP_ROLLBACK_ENABLE=y
CONFIG_BT_BLUEDROID_ENABLED=y
CONFIG_BT_NIMBLE_ENABLED=n
```
